## main/Kconfig.projbuild
```kconfig
menu "Thermal Management WiFi"

config ESP_WIFI_SSID
    string "WiFi SSID"
    default "myssid"

config ESP_WIFI_PASSWORD
    string "WiFi Password"
    default "mypassword"

endmenu
```
